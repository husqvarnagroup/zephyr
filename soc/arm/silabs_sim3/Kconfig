## soc/arm/silabs_sim3/Kconfig
```kconfig
config SOC_FAMILY_SIM3
	bool
	select HAS_SEGGER_RTT
	select BUILD_OUTPUT_HEX

if SOC_FAMILY_SIM3

config SOC_FAMILY
	string
	default "silabs_sim3"

config SOC_SIM3_FAST_CLOCK
	bool "Enable fast clock speeds"

source "soc/arm/silabs_sim3/*/Kconfig.soc"

endif # SOC_FAMILY_SIM3
```

## soc/arm/silabs_sim3/sim3u/Kconfig.defconfig.series
```kconfig
# Kconfig - SIM3U series configuration options

#
# Copyright (c) 2019 Christian Taedcke
#
# SPDX-License-Identifier: Apache-2.0
#

if SOC_SERIES_SIM3U

config SOC_SERIES
	default "sim3u"

config SOC_PART_NUMBER
	default "SIM3U167-A-GM" if SOC_PART_NUMBER_SIM3U167_A_GM

config NUM_IRQS
	int
	# must be >= the highest interrupt number used
	default 53

source "soc/arm/silabs_sim3/sim3u/Kconfig.defconfig.sim3u"

endif # SOC_SERIES_SIM3U
```

## soc/arm/silabs_sim3/sim3u/Kconfig.defconfig.sim3u
```kconfig
if SOC_SERIES_SIM3U

config SOC_SERIES
        default "sim3u"

config SYS_CLOCK_HW_CYCLES_PER_SEC
	default $(dt_node_int_prop_int,/cpus/cpu@0,clock-frequency)

config NUM_IRQS
        default 53

endif # SOC_SERIES_SIM3U
```

## soc/silabs/silabs_s2/Kconfig.soc
```kconfig
# Copyright (c) 2017 Christian Taedcke
# SPDX-License-Identifier: Apache-2.0

config SOC_FAMILY_SILABS_S2
	bool
	select SOC_GECKO

rsource "*/Kconfig.soc"
```

## tests/drivers/crypto/cipher/testcase.yaml
```yaml
# Copyright (c) 2024 GARDENA GmbH
#
# SPDX-License-Identifier: Apache-2.0

common:
  tags: crypto
  min_ram: 32
tests:
  drivers.crypto.cipher:
    filter: dt_nodelabel_enabled("crypto")
  drivers.crypto.cipher.tinycrypt:
    extra_args: EXTRA_CONF_FILE=overlay-tinycrypt-shim.conf
    integration_platforms:
      - native_sim
      - native_sim/native/64
  drivers.crypto.cipher.mbedtls:
    extra_args: EXTRA_CONF_FILE=overlay-mbedtls-shim.conf
    integration_platforms:
      - native_sim
      - native_sim/native/64
```

## tests/drivers/transceiver/si4467/testcase.yaml
```yaml
tests:
  drivers.transceiver.si4467.nrf52840dk_nrf52840:
    platform_allow: nrf52840dk_nrf52840
    tags: testing
    extra_args: SHIELD=ezradiopro_dk_si4467_v2
```

## tests/samples/subsys/factory_data/testcase.yaml
```yaml
tests:
  samples.factory_data:
    platform_allow: >
      native_sim
      native_sim/native/64
    tags: factory_data
```

## tests/subsys/factory_data/generic/testcase.yaml
```yaml
tests:
  system.factory_data.fcb:
    platform_allow:
      - native_sim
      - native_sim/native/64
      - nrf52840dk/nrf52840
    tags: factory_data
    extra_args: OVERLAY_CONFIG=fcb.conf
  system.factory_data.lv:
    platform_allow:
      - native_sim
      - native_sim/native/64
      - nrf52840dk/nrf52840
    tags: factory_data
    extra_args: CONFIG_FACTORY_DATA_LV=y
  system.factory_data.dummy:
    platform_allow:
      - nrf52840dk/nrf52840
    tags: factory_data
    extra_args: CONFIG_FACTORY_DATA_DUMMY=y
    build_only: true
```

## tests/subsys/factory_data/uninitialized/testcase.yaml
```yaml
tests:
  system.factory_data_uninitialized.fcb:
    platform_allow: >
      native_sim
      native_sim_64
      nrf52840dk_nrf52840
    tags: factory_data
    extra_args: OVERLAY_CONFIG=fcb.conf
  system.factory_data_uninitialized.lv:
    platform_allow: >
      native_sim
      native_sim_64
      nrf52840dk_nrf52840
    tags: factory_data
    extra_args: CONFIG_FACTORY_DATA_LV=y
  system.factory_data_uninitialized.dummy:
    platform_allow: >
      nrf52840dk_nrf52840
    tags: factory_data
    extra_args: CONFIG_FACTORY_DATA_DUMMY=y
    build_only: true
```
