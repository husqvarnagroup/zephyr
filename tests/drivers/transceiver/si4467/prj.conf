## CMakeLists.txt
```
# SPDX-License-Identifier: Apache-2.0

cmake_minimum_required(VERSION 3.13.1)
find_package(Zephyr REQUIRED HINTS $ENV{ZEPHYR_BASE})
project(si4467)

FILE(GLOB app_sources src/main.c src/test_si4467_hw.c)
target_sources(app PRIVATE ${app_sources})
```

## prj.conf
```kconfig
CONFIG_ZTEST=y

# Enable and configure Si4467 code
CONFIG_TRX=y
CONFIG_TRX_SI4467=y
# CONFIG_TRX_SI4467_SHELL is not set
CONFIG_TRX_SI4467_CALIBRATION_PERSISTENT_STORAGE=y

# We want to test for certin assertions to fail
CONFIG_ZTEST_ASSERT_HOOK=y

# Flash & file system
CONFIG_FLASH=y
CONFIG_FLASH_MAP=y
CONFIG_FLASH_PAGE_LAYOUT=y

# use simpler NVS backend for tests (fs backend gives an error)
CONFIG_NVS=y
CONFIG_SETTINGS_NVS=y
```

## src/main.c
```c
/*
 * Copyright (c) 2020 GARDENA GmbH
 *
 * SPDX-License-Identifier: Apache-2.0
 */

#include "test_si4467_hw.h"

#include <drivers/transceiver/si4467.h>

#include <ztest.h>
#include <ztest_error_hook.h>

static void test_si4467_chip_interrupt_to_byte(void)
{
	zassert_equal(0x7F,
		      si4467_chip_interrupt_to_byte((struct chip_interrupt){
			      .cal = 1,
			      .fifo_underflow_overflow_error = 1,
			      .state_change = 1,
			      .cmd_error = 1,
			      .chip_ready = 1,
			      .low_batt = 1,
			      .wut = 1,
		      }),
		      "All possible fields set");
	zassert_equal(0,
		      si4467_chip_interrupt_to_byte(
			      (struct chip_interrupt){ .unused = 1 }),
		      "Unused field has no effect");
	zassert_equal(BIT(6),
		      si4467_chip_interrupt_to_byte(
			      (struct chip_interrupt){ .cal = 1 }),
		      "cal bit");
	zassert_equal(BIT(5),
		      si4467_chip_interrupt_to_byte((struct chip_interrupt){
			      .fifo_underflow_overflow_error = 1 }),
		      "fifo_underflow_overflow_error bit");
	zassert_equal(BIT(4),
		      si4467_chip_interrupt_to_byte(
			      (struct chip_interrupt){ .state_change = 1 }),
		      "state_change bit");
	zassert_equal(BIT(3),
		      si4467_chip_interrupt_to_byte(
			      (struct chip_interrupt){ .cmd_error = 1 }),
		      "cmd_error bit");
	zassert_equal(BIT(2),
		      si4467_chip_interrupt_to_byte(
			      (struct chip_interrupt){ .chip_ready = 1 }),
		      "chip_ready bit");
	zassert_equal(BIT(1),
		      si4467_chip_interrupt_to_byte(
			      (struct chip_interrupt){ .low_batt = 1 }),
		      "low_batt bit");
	zassert_equal(BIT(0),
		      si4467_chip_interrupt_to_byte(
			      (struct chip_interrupt){ .wut = 1 }),
		      "wut bit");
	zassert_equal(
		0x00,
		si4467_chip_interrupt_to_byte((struct chip_interrupt){ 0 }),
		"No fields set");
}

static void test_si4467_modem_interrupt_to_byte(void)
{
	zassert_equal(0xFF,
		      si4467_modem_interrupt_to_byte(
			      (struct modem_interrupt){ .rssi_latch = 1,
							.postamble_detect = 1,
							.invalid_sync = 1,
							.rssi_jump = 1,
							.rssi = 1,
							.invalid_preamble = 1,
							.preamble_detect = 1,
							.sync_detect = 1 }),
		      "All fields set");
	zassert_equal(BIT(7),
		      si4467_modem_interrupt_to_byte(
			      (struct modem_interrupt){ .rssi_latch = 1 }),
		      "rssi_latch bit");
	zassert_equal(BIT(6),
		      si4467_modem_interrupt_to_byte((struct modem_interrupt){
			      .postamble_detect = 1 }),
		      "postamble_detect bit");
	zassert_equal(BIT(5),
		      si4467_modem_interrupt_to_byte(
			      (struct modem_interrupt){ .invalid_sync = 1 }),
		      "invalid_sync bit");
	zassert_equal(BIT(4),
		      si4467_modem_interrupt_to_byte(
			      (struct modem_interrupt){ .rssi_jump = 1 }),
		      "rssi_jump bit");
	zassert_equal(BIT(3),
		      si4467_modem_interrupt_to_byte(
			      (struct modem_interrupt){ .rssi = 1 }),
		      "rssi bit");
	zassert_equal(BIT(2),
		      si4467_modem_interrupt_to_byte((struct modem_interrupt){
			      .invalid_preamble = 1 }),
		      "invalid_preamble bit");
	zassert_equal(BIT(1),
		      si4467_modem_interrupt_to_byte(
			      (struct modem_interrupt){ .preamble_detect = 1 }),
		      "preamble_detect bit");
	zassert_equal(BIT(0),
		      si4467_modem_interrupt_to_byte(
			      (struct modem_interrupt){ .sync_detect = 1 }),
		      "sync_detect bit");
	zassert_equal(
		0x00,
		si4467_modem_interrupt_to_byte((struct modem_interrupt){ 0 }),
		"No fields set");
}

static void test_si4467_packet_handler_interrupt_to_byte(void)
{
	zassert_equal(0xFF,
		      si4467_packet_handler_interrupt_to_byte(
			      (struct packet_handler_interrupt){
				      .filter_match = 1,
				      .filter_miss = 1,
				      .packet_sent = 1,
				      .packet_rx = 1,
				      .crc_error = 1,
				      .alt_crc_error = 1,
				      .tx_fifo_almost_empty = 1,
				      .rx_fifo_almost_full = 1 }),
		      "All fields set");
	zassert_equal(
		BIT(7),
		si4467_packet_handler_interrupt_to_byte(
			(struct packet_handler_interrupt){ .filter_match = 1 }),
		"filter_match bit");
	zassert_equal(
		BIT(6),
		si4467_packet_handler_interrupt_to_byte(
			(struct packet_handler_interrupt){ .filter_miss = 1 }),
		"filter_miss bit");
	zassert_equal(
		BIT(5),
		si4467_packet_handler_interrupt_to_byte(
			(struct packet_handler_interrupt){ .packet_sent = 1 }),
		"packet_sent bit");
	zassert_equal(
		BIT(4),
		si4467_packet_handler_interrupt_to_byte(
			(struct packet_handler_interrupt){ .packet_rx = 1 }),
		"packet_rx bit");
	zassert_equal(
		BIT(3),
		si4467_packet_handler_interrupt_to_byte(
			(struct packet_handler_interrupt){ .crc_error = 1 }),
		"crc_error bit");
	zassert_equal(
		BIT(2),
		si4467_packet_handler_interrupt_to_byte((
			struct packet_handler_interrupt){ .alt_crc_error = 1 }),
		"alt_crc_error bit");
	zassert_equal(BIT(1),
		      si4467_packet_handler_interrupt_to_byte(
			      (struct packet_handler_interrupt){
				      .tx_fifo_almost_empty = 1 }),
		      "tx_fifo_almost_empty bit");
	zassert_equal(BIT(0),
		      si4467_packet_handler_interrupt_to_byte(
			      (struct packet_handler_interrupt){
				      .rx_fifo_almost_full = 1 }),
		      "rx_fifo_almost_full bit");
	zassert_equal(0x00,
		      si4467_packet_handler_interrupt_to_byte(
			      (struct packet_handler_interrupt){ 0 }),
		      "No fields set");
}

static void test_si4467_is_valid_next_operating_state(void)
{
	zassert_true(si4467_is_valid_next_operating_state(0), "No change");
	zassert_true(si4467_is_valid_next_operating_state(1), "SLEEP");
	zassert_true(si4467_is_valid_next_operating_state(2), "SPI_ACTIVE");
	zassert_true(si4467_is_valid_next_operating_state(3), "READY");
	zassert_false(si4467_is_valid_next_operating_state(4), "Invalid");
	zassert_true(si4467_is_valid_next_operating_state(5), "TX_TUNE");
	zassert_true(si4467_is_valid_next_operating_state(6), "RX_TUNE");
	zassert_true(si4467_is_valid_next_operating_state(7), "TX");
	zassert_true(si4467_is_valid_next_operating_state(8), "RX");
	zassert_false(si4467_is_valid_next_operating_state(9), "Invalid");
	/* [10,254] also invalid */
	zassert_false(si4467_is_valid_next_operating_state(255), "Invalid");
}

static void test_si4467_modem_interrupt_present(void)
{
	struct modem_interrupt i = {};

	/* No flags */
	zassert_false(si4467_modem_interrupt_present(i), "No flags");

	/* Single flags */
	i = (struct modem_interrupt){ .rssi_latch = 1 };
	zassert_true(si4467_modem_interrupt_present(i), "rssi_latch set");

	i = (struct modem_interrupt){ .postamble_detect = 1 };
	zassert_true(si4467_modem_interrupt_present(i), "postamble_detect set");

	i = (struct modem_interrupt){ .invalid_sync = 1 };
	zassert_true(si4467_modem_interrupt_present(i), "invalid_sync set");

	i = (struct modem_interrupt){ .rssi_jump = 1 };
	zassert_true(si4467_modem_interrupt_present(i), "rssi_jump set");

	i = (struct modem_interrupt){ .rssi = 1 };
	zassert_true(si4467_modem_interrupt_present(i), " rssi set");

	i = (struct modem_interrupt){ .invalid_preamble = 1 };
	zassert_true(si4467_modem_interrupt_present(i), "invalid_preamble set");

	i = (struct modem_interrupt){ .preamble_detect = 1 };
	zassert_true(si4467_modem_interrupt_present(i), "preamble_detect set");

	i = (struct modem_interrupt){ .sync_detect = 1 };
	zassert_true(si4467_modem_interrupt_present(i), "sync_detect set");

	/* Multiple flags */
	i = (struct modem_interrupt){ .rssi_latch = 1, .sync_detect = 1 };
	zassert_true(si4467_modem_interrupt_present(i),
		     "rssi_latch and sync_detect set");
}

static void test_si4467_chip_interrupt_present(void)
{
	struct chip_interrupt i = {};

	/* No flags */
	zassert_false(si4467_chip_interrupt_present(i), "No flags");

	i.unused = 1;
	zassert_false(si4467_chip_interrupt_present(i), "Unused flag");

	/* Single flags */
	i = (struct chip_interrupt){ .cal = 1 };
	zassert_true(si4467_chip_interrupt_present(i), "cal set");

	i = (struct chip_interrupt){ .fifo_underflow_overflow_error = 1 };
	zassert_true(si4467_chip_interrupt_present(i),
		     "fifo_underflow_overflow_error set");

	i = (struct chip_interrupt){ .state_change = 1 };
	zassert_true(si4467_chip_interrupt_present(i), "state_change set");

	i = (struct chip_interrupt){ .cmd_error = 1 };
	zassert_true(si4467_chip_interrupt_present(i), "cmd_error set");

	i = (struct chip_interrupt){ .chip_ready = 1 };
	zassert_true(si4467_chip_interrupt_present(i), " chip_ready set");

	i = (struct chip_interrupt){ .low_batt = 1 };
	zassert_true(si4467_chip_interrupt_present(i), "low_batt set");

	i = (struct chip_interrupt){ .wut = 1 };
	zassert_true(si4467_chip_interrupt_present(i), "wut set");

	/* Multiple flags */
	i = (struct chip_interrupt){ .cal = 1, .wut = 1 };
	zassert_true(si4467_chip_interrupt_present(i), "cal and wut set");
}

static void test_si4467_packet_handler_interrupt_present(void)
{
	struct packet_handler_interrupt i = {};

	/* No flags */
	zassert_false(si4467_packet_handler_interrupt_present(i), "No flags");

	/* Single flags */
	i = (struct packet_handler_interrupt){ .filter_match = 1 };
	zassert_true(si4467_packet_handler_interrupt_present(i),
		     "filter_match set");

	i = (struct packet_handler_interrupt){ .filter_miss = 1 };
	zassert_true(si4467_packet_handler_interrupt_present(i),
		     "filter_miss set");

	i = (struct packet_handler_interrupt){ .packet_sent = 1 };
	zassert_true(si4467_packet_handler_interrupt_present(i),
		     "packet_sent set");

	i = (struct packet_handler_interrupt){ .packet_rx = 1 };
	zassert_true(si4467_packet_handler_interrupt_present(i),
		     "packet_rx set");

	i = (struct packet_handler_interrupt){ .crc_error = 1 };
	zassert_true(si4467_packet_handler_interrupt_present(i),
		     " crc_error set");

	i = (struct packet_handler_interrupt){ .alt_crc_error = 1 };
	zassert_true(si4467_packet_handler_interrupt_present(i),
		     "alt_crc_error set");

	i = (struct packet_handler_interrupt){ .tx_fifo_almost_empty = 1 };
	zassert_true(si4467_packet_handler_interrupt_present(i),
		     "tx_fifo_almost_empty set");

	i = (struct packet_handler_interrupt){ .rx_fifo_almost_full = 1 };
	zassert_true(si4467_packet_handler_interrupt_present(i),
		     "rx_fifo_almost_full set");

	/* Multiple flags */
	i = (struct packet_handler_interrupt){ .filter_match = 1,
					       .rx_fifo_almost_full = 1 };
	zassert_true(si4467_packet_handler_interrupt_present(i),
		     "filter_match and rx_fifo_almost_full set");
}

static void test_si4467_si4467_property_group_size(void)
{
	ztest_set_assert_valid(true);
	zassert_equal(
		si4467_property_group_size((enum si4467_property_group)0xFF),
		-EINVAL, "0xFF is not a valid property group");

	ztest_set_assert_valid(false);
	zassert_equal(si4467_property_group_size(SI4467_PROPERTY_GROUP_GLOBAL),
		      11, "Property group global has 11 bytes");
}

static void test_si4467_get_xtal_frequency(void)
{
	zassert_equal(si4467_get_xtal_frequency(), 26000000,
		      "Code has only been tested with 26 MHz crystal.");
}

static void test_si4467_property_group_str(void)
{
	zassert_equal(
		strcmp(si4467_property_group_str(SI4467_PROPERTY_GROUP_RX_HOP),
		       "RX_HOP"),
		0, NULL);
}

static void test_si4467_property_modem_clkgen_band_sy_sel_str(void)
{
	const enum si4467_property_modem_clkgen_band_sy_sel p =
		SI4467_PROPERTY_MODEM_CLKGEN_BAND_SY_SEL_LOW_POWER;

	zassert_equal(strcmp(si4467_property_modem_clkgen_band_sy_sel_str(p),
			     "Low power"),
		      0, NULL);
}

static void test_si4467_property_modem_clkgen_band_band_to_outdiv(void)
{
	zassert_equal(
		si4467_property_modem_clkgen_band_band_to_outdiv(
			SI4467_PROPERTY_MODEM_CLKGEN_BAND_BAND_FVCO_DIV_4),
		4, 0, "Output is FVCO/4");

	zassert_equal(
		si4467_property_modem_clkgen_band_band_to_outdiv(
			SI4467_PROPERTY_MODEM_CLKGEN_BAND_BAND_FVCO_DIV_24),
		24, 0, "Output is FVCO/24");
	zassert_equal(
		si4467_property_modem_clkgen_band_band_to_outdiv(
			SI4467_PROPERTY_MODEM_CLKGEN_BAND_BAND_FVCO_DIV_24_2),
		24, 0, "Output is FVCO/24");
	zassert_equal(
		si4467_property_modem_clkgen_band_band_to_outdiv(
			SI4467_PROPERTY_MODEM_CLKGEN_BAND_BAND_FVCO_DIV_24_3),
		24, 0, "Output is FVCO/24");
}

static void test_si4467_pa_dbm_to_pwr_lvl(void)
{
	zassert_equal(si4467_pa_dbm_to_pwr_lvl(0), 9,
		      "correct calculation of LUT low value");
	zassert_equal(si4467_pa_dbm_to_pwr_lvl(11), 60,
		      "correct calculation of LUT high value");
	zassert_equal(si4467_pa_dbm_to_pwr_lvl(12), 0x4f,
		      "correct calculation of value above LUT");
	zassert_equal(si4467_pa_dbm_to_pwr_lvl(100), 0x4f,
		      "correct calculation of value above LUT");
	zassert_equal(si4467_pa_dbm_to_pwr_lvl(255), 0x4f,
		      "correct calculation of value above LUT");
}

void test_main(void)
{
	ztest_test_suite(
		sw_tests, ztest_unit_test(test_si4467_chip_interrupt_to_byte),
		ztest_unit_test(test_si4467_modem_interrupt_to_byte),
		ztest_unit_test(test_si4467_packet_handler_interrupt_to_byte),
		ztest_unit_test(test_si4467_is_valid_next_operating_state),
		ztest_unit_test(test_si4467_modem_interrupt_present),
		ztest_unit_test(test_si4467_chip_interrupt_present),
		ztest_unit_test(test_si4467_packet_handler_interrupt_present),
		ztest_unit_test(test_si4467_si4467_property_group_size),
		ztest_unit_test(test_si4467_property_group_str),
		ztest_unit_test(test_si4467_get_xtal_frequency),
		ztest_unit_test(
			test_si4467_property_modem_clkgen_band_sy_sel_str),
		ztest_unit_test(
			test_si4467_property_modem_clkgen_band_band_to_outdiv),
		ztest_unit_test(test_si4467_pa_dbm_to_pwr_lvl));

	ztest_run_test_suite(sw_tests);

	test_si4467_hw_init();
	ztest_test_suite(
		hw_tests, ztest_unit_test(test_si4467_hw_restart),
		ztest_unit_test_setup_teardown(
			test_si4467_hw_properties_set_and_get_one,
			test_si4467_hw_setup, unit_test_noop),
		ztest_unit_test_setup_teardown(
			test_si4467_hw_properties_get_many,
			test_si4467_hw_setup, unit_test_noop),
		ztest_unit_test_setup_teardown(
			test_si4467_hw_configure_rx_hopping,
			test_si4467_hw_setup, unit_test_noop),
		ztest_unit_test_setup_teardown(
			test_si4467_hw_get_property_clkgen_band,
			test_si4467_hw_setup, unit_test_noop),
		ztest_unit_test_setup_teardown(
			test_si4467_hw_get_property_freq_control_inte,
			test_si4467_hw_setup, unit_test_noop),
		ztest_unit_test_setup_teardown(
			test_si4467_hw_get_property_freq_control_frac,
			test_si4467_hw_setup, unit_test_noop),
		ztest_unit_test_setup_teardown(
			test_si4467_hw_get_property_freq_control_channel_ss,
			test_si4467_hw_setup, unit_test_noop),
		ztest_unit_test_setup_teardown(
			test_si4467_hw_get_property_rx_hop_control,
			test_si4467_hw_setup, unit_test_noop),
		ztest_unit_test_setup_teardown(
			test_si4467_hw_get_property_pwr_lvl,
			test_si4467_hw_setup, unit_test_noop),
		ztest_unit_test_setup_teardown(
			test_si4467_hw_set_property_pwr_lvl,
			test_si4467_hw_setup, unit_test_noop),
		ztest_unit_test_setup_teardown(
			test_si4467_hw_calibration,
			test_si4467_hw_setup, unit_test_noop),
		ztest_unit_test_setup_teardown(
			test_si4467_hw_patch,
			test_si4467_hw_setup, unit_test_noop));

	ztest_run_test_suite(hw_tests);
}
```

## src/test_si4467_hw.c
```c
/*
 * Copyright (c) 2021 GARDENA GmbH
 *
 * SPDX-License-Identifier: Apache-2.0
 */

#include "test_si4467_hw.h"

#include <ztest.h>
#include <ztest_error_hook.h>

#include <drivers/transceiver/si4467.h>

static struct si4467_context ctx;

struct device dev = {
	.data = &ctx,
};

static int
test_si4467_state_dispatch_nirq_events(struct si4467_context *const ctx_si4467)
{
	return 0;
}

void test_si4467_hw_init(void)
{
	zassert_ok(si4467_init(&dev, test_si4467_state_dispatch_nirq_events),
		   "Successful startup expected");
}

void test_si4467_hw_setup(void)
{
	zassert_ok(si4467_start(&dev), "Successful startup expected");
}

void test_si4467_hw_properties_get_many(void)
{
	uint8_t rx_hop_bytes[66];

	zassert_true(si4467_command_get_properties(
			     &ctx, SI4467_PROPERTY_GROUP_RX_HOP,
			     SI4467_PROPERTY_RX_HOP_CONTROL, rx_hop_bytes,
			     17) < 0,
		     "No more than 16 property bytes can be fetched at once");

	zassert_ok(si4467_command_get_properties(
			   &ctx, SI4467_PROPERTY_GROUP_RX_HOP,
			   SI4467_PROPERTY_RX_HOP_CONTROL, rx_hop_bytes, 16),
		   "Getting control, table_size and first 14 table entries");
	zassert_equal(rx_hop_bytes[0], 0x04,
		      "Default: Hopping disabled, 4 nibbles RSSI timeout");
	zassert_equal(rx_hop_bytes[1], 1, "Default: Table size of one");
	zassert_equal(rx_hop_bytes[2], 0, "Default: Entry 0 has value 0");
	zassert_equal(rx_hop_bytes[3], 1, "Default: Entry 1 has value 1");
	/* ...many more... */
	zassert_equal(rx_hop_bytes[15], 13, "Default: Entry 13 has value 13");
}

void test_si4467_hw_restart(void)
{
	zassert_ok(si4467_start(&dev), "Successful startup expected");
	zassert_ok(si4467_start(&dev), "Successful restart expected");
	zassert_ok(si4467_start(&dev), "Successful restart expected");
}

void test_si4467_hw_properties_set_and_get_one(void)
{
	uint8_t rx_hop_byte;

	zassert_ok(si4467_command_set_property(
			   &ctx, SI4467_PROPERTY_GROUP_RX_HOP,
			   SI4467_PROPERTY_RX_HOP_TABLE_SIZE, 2),
		   "Setting RX hopping table size to two");

	zassert_ok(si4467_command_get_properties(
			   &ctx, SI4467_PROPERTY_GROUP_RX_HOP,
			   SI4467_PROPERTY_RX_HOP_TABLE_SIZE, &rx_hop_byte, 1),
		   "Expecting hopping table size to be actually two");
}

void test_si4467_hw_configure_rx_hopping(void)
{
	const uint8_t channels[5] = { 10, 11, 12, 13, 55 };
	const struct si4467_property_group_rx_hop_control config = {
		.rssi_timeout = 0xF,
		.enable = SI4467_PROPERTY_RX_HOP_CONTROL_EN_PM_RSSI_PM_SYNC_TO,
	};
	uint8_t property_bytes[8];

	zassert_equal(si4467_configure_rx_hopping(&ctx, &config, NULL, 65),
		      -EINVAL, "Refusing invalid table size");

	zassert_ok(si4467_configure_rx_hopping(&ctx, &config, channels,
					       ARRAY_SIZE(channels)),
		   "Applying must be Successful");

	zassert_ok(si4467_command_get_properties(
			   &ctx, SI4467_PROPERTY_GROUP_RX_HOP,
			   SI4467_PROPERTY_RX_HOP_CONTROL, property_bytes,
			   ARRAY_SIZE(property_bytes)),
		   "Fetching property bytes must work");

	zassert_equal(property_bytes[0], 0x4F,
		      "HOP_RSSI_PM_SYNC_TO and max RSSI timeout set");
	zassert_equal(property_bytes[1], 5, "Table size of 5");
	zassert_equal(property_bytes[2], 10, "Channel entry 0 is 10");
	zassert_equal(property_bytes[3], 11, "Channel entry 1 is 11");
	zassert_equal(property_bytes[4], 12, "Channel entry 2 is 12");
	zassert_equal(property_bytes[5], 13, "Channel entry 3 is 13");
	zassert_equal(property_bytes[6], 55, "Channel entry 4 is 55");
	zassert_equal(property_bytes[7], 0xFF, "Unused channel entry 5 = 0xFF");
}

void test_si4467_hw_get_property_clkgen_band(void)
{
	struct si4467_property_modem_clkgen_band band;

	zassert_ok(si4467_get_property_clkgen_band(&ctx, &band),
		   "No failure expected");

	zassert_equal(band.band,
		      SI4467_PROPERTY_MODEM_CLKGEN_BAND_BAND_FVCO_DIV_4,
		      "Default is 900 MHz band");
	zassert_equal(band.sy_sel,
		      SI4467_PROPERTY_MODEM_CLKGEN_BAND_SY_SEL_HIGH_PERFORMANCE,
		      "Default is high performance mode");
	zassert_equal(band.force_sy_recal,
		      SI4467_PROPERTY_MODEM_CLKGEN_BAND_FORCE_SY_RECAL_FORCE,
		      "Force recalibration is enabled by default");
}

void test_si4467_hw_get_property_freq_control_inte(void)
{
	uint8_t inte;

	zassert_ok(si4467_get_property_freq_control_inte(&ctx, &inte),
		   "No failure expected");

	zassert_equal(inte, 0x3C, "Default value is 0x3c");
}

void test_si4467_hw_get_property_freq_control_frac(void)
{
	uint32_t frac;

	zassert_ok(si4467_get_property_freq_control_frac(&ctx, &frac),
		   "No failure expected");

	zassert_equal(frac, 0x080000, "Default value is 0x080000");
}

void test_si4467_hw_get_property_freq_control_channel_ss(void)
{
	uint16_t step_size;

	zassert_ok(si4467_get_property_freq_control_channel_step_size(
			   &ctx, &step_size),
		   "No failure expected");

	zassert_equal(step_size, 0x0000, "Default value is 0x0000");
}

void test_si4467_hw_get_property_rx_hop_control(void)
{
	struct si4467_property_group_rx_hop_control control;

	zassert_ok(si4467_get_property_rx_hop_control(&ctx, &control),
		   "No failure expected");

	zassert_equal(control.enable, SI4467_PROPERTY_RX_HOP_CONTROL_EN_DISABLE,
		      "Hopping should be disabled");
	zassert_equal(control.rssi_timeout, 0x4, "Default RSSI timeout is 0x4");
}

void test_si4467_hw_get_property_pwr_lvl(void)
{
	uint8_t power_level;

	zassert_ok(si4467_get_property_pwr_lvl(&ctx, &power_level),
		   "No failure expected");

	/*
	 * note: we get the chip default here, not what we have in WDS config
	 * (as WDS config is not loaded for tests)
	 */
	zassert_equal(power_level, 0x7f, "Default power level expected");
}

void test_si4467_hw_set_property_pwr_lvl(void)
{
	zassert_ok(si4467_set_property_pwr_lvl(&ctx, 0), "No failure expected");

	zassert_ok(si4467_set_property_pwr_lvl(&ctx, 0x7f),
		   "No failure expected");

	uint8_t power_level;

	zassert_ok(si4467_get_property_pwr_lvl(&ctx, &power_level),
		   "No failure expected");
	zassert_equal(power_level, 0x7f, "Updated power level expected");

	zassert_equal(si4467_set_property_pwr_lvl(&ctx, 0x8f), -EINVAL,
		      "-EINVAL expected");

	zassert_ok(si4467_get_property_pwr_lvl(&ctx, &power_level),
		   "No failure expected");
	zassert_equal(power_level, 0x7f, "Unchanged power level expected");
}

void test_si4467_hw_calibration(void)
{
	uint8_t tune_value;

	zassert_equal(si4467_command_set_xo_tune_value(&ctx, 130), -EINVAL,
		      "tune value outside valid range");

	zassert_ok(si4467_command_set_xo_tune_value(&ctx, 10),
		      "set valid tune value");

	zassert_ok(si4467_save_calibration(&ctx), "store tune value");

	zassert_ok(si4467_command_set_xo_tune_value(&ctx, 20),
		      "set valid tune value");

	zassert_ok(si4467_command_get_xo_tune_value(&ctx, &tune_value),
		   "tune value readout OK");
	zassert_equal(tune_value, 20, "correct tune value read");

	zassert_ok(si4467_restore_calibration(&ctx),
		   "restore previous tune value");

	zassert_ok(si4467_command_get_xo_tune_value(&ctx, &tune_value),
		   "tune value readout OK");
	zassert_equal(tune_value, 10, "previous tune value correctly restored");
}

void test_si4467_hw_patch(void)
{
	struct func_information info;

	zassert_ok(si4467_command_func_info(&ctx, &info), "get func_info");

	zassert_equal(info.patch, 0xD046, "correct patch applied");
}
```

## src/test_si4467_hw.h
```c
/*
 * Copyright (c) 2021 GARDENA GmbH
 *
 * SPDX-License-Identifier: Apache-2.0
 */

#ifndef ZEPHYR_TESTS_DRIVERS_TRANSCEIVERS_SI4467_H
#define ZEPHYR_TESTS_DRIVERS_TRANSCEIVERS_SI4467_H

#ifdef __cplusplus
extern "C" {
#endif

/**
 * Initialize hardware - call once before running any of the hardware dependent
 * tests.
 */
void test_si4467_hw_init(void);

/** Setup up function - call for each tests. */
void test_si4467_hw_setup(void);

/**
 * All tests rely on the device being able be reset during test setup phase -
 * test this first.
 */
void test_si4467_hw_restart(void);

void test_si4467_hw_properties_set_and_get_one(void);
void test_si4467_hw_properties_get_many(void);
void test_si4467_hw_configure_rx_hopping(void);
void test_si4467_hw_get_property_clkgen_band(void);

void test_si4467_hw_get_property_freq_control_inte(void);
void test_si4467_hw_get_property_freq_control_frac(void);
/* ss = step_size abbreviation */
void test_si4467_hw_get_property_freq_control_channel_ss(void);
void test_si4467_hw_get_property_rx_hop_control(void);
void test_si4467_hw_get_property_pwr_lvl(void);
void test_si4467_hw_set_property_pwr_lvl(void);
void test_si4467_hw_calibration(void);
void test_si4467_hw_patch(void);

#ifdef __cplusplus
}
#endif

#endif /* ZEPHYR_TESTS_DRIVERS_TRANSCEIVERS_SI4467_H_ */
```
