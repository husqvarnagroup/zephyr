/*
 * Copyright (c) 2022 GARDENA GmbH
 * SPDX-License-Identifier: Apache-2.0
 */

/delete-node/ &storage_partition;

&flash0 {
    partitions {
        /* Reduce storage partition to 12 kB. */
        storage_partition: partition@f8000 {
            reg = <0x000f8000 0x00003000>;
        };
        /* factory data: 1 page (4 kB) */
        factory_partition: partition@fb000 {
            label = "factory";
            reg = <0x000fb000 0x00001000>;
        };
    };
};
