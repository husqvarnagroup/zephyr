## boards/arm/gardena_rm_sim3u/Kconfig.defconfig
```kconfig
if BOARD_GARDENA_RM_SIM3U

config BOARD
	default "gardena_rm_sim3u"

endif # BOARD_GARDENA_RM_SIM3U
```

## boards/arm/gardena_rm_sim3u/gardena_rm_sim3u_defconfig
```kconfig
CONFIG_SOC_SERIES_SIM3U=y

# enable uart driver
CONFIG_SERIAL=y

# enable console
CONFIG_CONSOLE=y
CONFIG_UART_CONSOLE=y

# enable GPIO
CONFIG_GPIO=y

CONFIG_TEST_RANDOM_GENERATOR=y
CONFIG_TIMER_RANDOM_GENERATOR=y

CONFIG_SPI=y
CONFIG_TRX=y
CONFIG_TRX_SI4467=y
CONFIG_TRX_SI4467_RX_TX_GPIO=y
CONFIG_TRX_SI4467_RF_CONTROL_RX_HANDLING=y
CONFIG_TRX_SI4467_RF_CONTROL_TX_HANDLING=y
```

## boards/gardena/rm_sim3u/Kconfig.rm_sim3u
```kconfig
# Copyright (c) 2024 GARDENA GmbH
#
# SPDX-License-Identifier: Apache-2.0

config BOARD_RM_SIM3U
	bool "GARDENA SiM3U radio module"
	select SOC_PART_NUMBER_SIM3U167BGM
```

## boards/gardena/rm_sim3u/board.yml
```yaml
# Copyright (c) 2024 GARDENA GmbH
#
# SPDX-License-Identifier: Apache-2.0

board:
  name: rm_sim3u
  vendor: gardena
  socs:
    - name: sim3u167bgm
```

## boards/gardena/sgrm/board.yml
```yaml
# Copyright (c) 2024 GARDENA GmbH
#
# SPDX-License-Identifier: Apache-2.0

board:
  name: sgrm
  vendor: gardena
  socs:
    - name: sim3u167
```

## boards/shields/ezradiopro_dk_si4467/Kconfig.defconfig
```kconfig
# Copyright (c) 2020 GARDENA GmbH

if SHIELD_EZRADIOPRO_DK_SI4467

config SPI
	default y

config TRX
	default y

config TRX_SI4467
	default y

config TRX_SI4467_RX_TX_GPIO
	default y

endif   # SHIELD_EZRADIOPRO_DK_SI4467
```

## boards/shields/ezradiopro_dk_si4467/Kconfig.shield
```kconfig
# Copyright (c) 2020 GARDENA GmbH

config SHIELD_EZRADIOPRO_DK_SI4467
	def_bool $(shields_list_contains,ezradiopro_dk_si4467) || $(shields_list_contains,ezradiopro_dk_si4467_v2) \
	      || $(shields_list_contains,ezradiopro_dk_si4467_arduino)
```

## boards/silabs/sim3u1xx_dk/Kconfig.sim3u1xx_dk
```kconfig
# Copyright (c) 2024 GARDENA GmbH
#
# SPDX-License-Identifier: Apache-2.0

config BOARD_SIM3U1XX_DK
	bool "Silicon Labs SiM3U1xx 32-bit MCU USB Development Kit"
	select SOC_PART_NUMBER_SIM3U167AGQ
```

## drivers/crypto/Kconfig.si32
```kconfig
# Copyright (c) 2024 GARDENA GmbH
# SPDX-License-Identifier: Apache-2.0

config CRYPTO_SI32
	bool "Si32 AES driver"
	default y
	depends on DT_HAS_SILABS_SI32_AES_ENABLED
	select DMA
	help
	  Enable hardware accelerated AES driver.
```

## drivers/spi/Kconfig.si32
```kconfig
config SPI_SI32
	bool "SI32 SPI controller driver"
	default y
	depends on DT_HAS_SILABS_SI32_SPI_ENABLED
```

## drivers/transceiver/Kconfig
```kconfig
# Transceiver driver configuration options

# Copyright (c) 2020 GARDENA GmbH
# SPDX-License-Identifier: Apache-2.0

#
# Transceiver Drivers
#
menuconfig TRX
	bool "Transceiver (TRX) drivers options"

if TRX

rsource "Kconfig.si4467"

module = TRX_DRIVER
module-str = Transceiver driver
module-help = Sets log level for transceiver drivers.
source "subsys/logging/Kconfig.template.log_config"

endif # TRX
```

## drivers/transceiver/Kconfig.si4467
```kconfig
# Silicon Labs Si4467 configuration options

# Copyright (c) 2020 GARDENA GmbH
# SPDX-License-Identifier: Apache-2.0

menuconfig TRX_SI4467
	bool "Silicon Labs 4467 Driver"
	select SPI
	select GPIO
	select NET_BUF
	select LOG2_ALWAYS_RUNTIME if LOG

if TRX_SI4467

config TRX_SI4467_DRV_NAME
	string "Silicon Labs 4467 Driver's Name"
	default "TRX_SI4467"
	help
	  This option sets the driver name.

config TRX_SI4467_APPLY_PATCH
	bool "Apply patch before power up"
	default y
	help
	  Enables patching the Si4467 before power up. This fixes several
	  problems (see "EZRadio and EZRadio Pro Family Rev C2A/A2A Device
	  Errata"), but adds about 15-26 ms boot time and increases the
	  application size by about 1 kB.

config TRX_SI4467_RX_STACK_SIZE
int "Driver's internal RX thread stack size"
	default 2048
	help
	  This option sets the driver's stack size for its internal RX thread.
	  The default value should be sufficient, but in case it proves to be
	  a too little one, this option makes it easy to play with the size.

config TRX_SI4467_SHELL
	bool "Enable Si4467 shell module"
	default y
	select SHELL
	help
	  This can be used for testing Si4467 through the console via exposing
	  a shell module named "si4467".

config TRX_SI4467_RANDOM_MAC
	bool "Random MAC address"
	default y
	help
	  Generate a random MAC address dynamically.

config TRX_SI4467_NIRQ_DEBUG
	bool "Toggle a pin while working on a nIRQ request"
	help
	  This option is intended to allow analyzing the time being spent in
	  the nIRQ interrupt handler using a logic analyzer. nirq-handling-gpios
	  must be configured in the device tree to use this.

config TRX_SI4467_RX_TX_GPIO
	bool "Use Si4467 GPIO 2/3 to indicate RX/TX state"
	help
	  This option configures Si4467 GPIO 2 to RX mode and GPIO 3 to TX mode.
	  This is useful for debugging or to control external hardware (such as
	  PA or LNA). This option is not needed when controlling external PA or
	  LNA from the MCU.

config TRX_SI4467_RF_CONTROL_RX_HANDLING
	bool "Toggle a pin to control an external RX component (e.g. LNA)"
	help
	  When enabled, a GPIO pin of the MCU is used to control external
	  components needed for RX, such as an LNA. This option is not needed,
	  if external components are controlled directly by a GPIO of the
	  Si4467. rx-enable-gpios must be configured in the device tree to use
	  this.

config TRX_SI4467_RF_CONTROL_TX_HANDLING
	bool "Toggle a pin to control external TX components (e.g. PA)"
	help
	  When enabled, a GPIO pin of the MCU is used to control external
	  components needed for TX, such as an PA. This option is not needed,
	  if external components are controlled directly by a GPIO of the
	  Si4467. tx-enable-gpios must be configured in the device tree to use
	  this.

config TRX_SI4467_ANTENNA_DIVERSITY_HANDLING
	bool "Toggle a pin to control antenna diversity"
	help
	  When enabled, a GPIO pin of the MCU is used to control an external
	  RF switch for antenna diversity. ant-diversity-gpios must be
	  configured in the device tree to use this.

config TRX_SI4467_CALIBRATION_PERSISTENT_STORAGE
	bool "Use persistent calibration data storage for crystal tuning value"
	select SETTINGS
	help
	  When enabled, Zephyr settings subsystem can be used to persistently
	  store calibration data.

config TRX_SI4467_CALIBRATION_SETTING_NAME
	string "Name to use for storing Si4467 calibration data in settings"
	default "factory/si4467_calibration"
	depends on TRX_SI4467_CALIBRATION_PERSISTENT_STORAGE
	help
	  This option sets name for the Si4467 calibration data setting.

endif
```

## dts/bindings/clock/silabs,hfxo.yaml
```yaml
# Copyright (c) 2024 GARDENA GmbH
#
# SPDX-License-Identifier: Apache-2.0

compatible: "silabs,hfxo"

include: fixed-clock.yaml

properties:
  ctune:
    type: int
    required: true
    description: Load capacitance configuration
  precision:
    type: int
    required: true
    description: Precision configuration
```

## dts/bindings/clock/silabs,si32-ahb.yaml
```yaml
description: Silabs SI32 AHB clock controller node

compatible: "silabs,si32-ahb"

include: base.yaml

properties:
  clocks:
    required: true
```

## dts/bindings/clock/silabs,si32-apb.yaml
```yaml
description: Silabs SI32 APB clock controller node

compatible: "silabs,si32-apb"

include: base.yaml

properties:
    clocks:
      required: true

    divider:
      type: int
      required: true
```

## dts/bindings/clock/silabs,si32-pll.yaml
```yaml
description: Silabs SI32 PLL clock controller node

compatible: "silabs,si32-pll"

include: base.yaml

properties:
    reg:
      required: true
```

## dts/bindings/flash_controller/silabs,si32-flash-controller.yaml
```yaml
compatible: "silabs,si32-flash-controller"

description: Silabs SI32 flash controller

include: flash-controller.yaml
```

## dts/bindings/misc/gardena,sgrm-antenna.yaml
```yaml
# Copyright (c) 2024 GARDENA GmbH
#
# SPDX-License-Identifier: Apache-2.0

description: Antenna related GPIO config for GARDENA smart garden radio module

compatible: "gardena,sgrm-antenna"

include: base.yaml

properties:
    diversity-mode-gpios:
        type: phandle-array
        required: true
    diversity-state-gpios:
        type: phandle-array
        required: true
    antenna-control-gpios:
        type: phandle-array
        required: true
    antenna-input-gpios:
        type: phandle-array
        required: true
    led-red-input-gpios:
        type: phandle-array
        required: true
    led-green-input-gpios:
        type: phandle-array
        required: true
    led-blue-input-gpios:
        type: phandle-array
        required: true
```

## dts/bindings/pinctrl/silabs,si32-pinctrl.yaml
```yaml
description: |
  Ailabs si32 pinctrl node.

compatible: "silabs,si32-pinctrl"

include:
  - name: base.yaml
  - name: pincfg-node-group.yaml
    child-binding:
      child-binding:
        property-allowlist:
          - input-enable
          - output-enable
          - output-low
          - output-high

child-binding:
  description: si32 pin controller pin group
  child-binding:
    description: |
      si32 pin controller pin configuration node
    properties:
      pinmux:
        required: true
        type: array
        description: |
          Pin mux selections for this group.
```

## dts/bindings/serial/silabs,si32-usart.yaml
```yaml
description: SI32 USART

compatible: "silabs,si32-usart"

include: [uart-controller.yaml, pinctrl-device.yaml]

properties:
    reg:
      required: true

    interrupts:
      required: true

    clocks:
      required: true
```

## dts/bindings/spi/silabs,si32-spi.yaml
```yaml
description: SI32 SPI

compatible: "silabs,si32-spi"

include: [spi-controller.yaml, pinctrl-device.yaml]

properties:
    reg:
      required: true

    interrupts:
      required: true

    clocks:
      required: true
```

## dts/bindings/transceiver/silabs,si4467.yaml
```yaml
# Copyright (c) 2021 GARDENA GmbH
# SPDX-License-Identifier: Apache-2.0

description: Silicon Labs Si4467 Sub-GHz transceiver

compatible: "silabs,si4467"

include: spi-device.yaml

properties:
    nirq-gpios:
      type: phandle-array
      required: true
      description: Interrupt pin.

        The interrupt pin nIRQ of Si4467 is active low input on the MCU.

    nirq-handling-gpios:
      type: phandle-array
      required: false
      description: Optional pin to analyze time spent handling the nIRQ.

    sdn-gpios:
      type: phandle-array
      required: true
      description: Shutdown pin.

        The shutdown (SDN) pin of Si4467 is active high.

    gpio-gpios:
      type: phandle-array
      required: true
      description: GPIO 0-3

        The GPIOs 0-3 pins of Si4467.

    xtal-frequency:
      type: int
      required: true
      description: Clock frequency of XTAL in Hz

    rx-enable-gpios:
      type: phandle-array
      required: false
      description: RX enable pin. Controls the TX/RX switch.

    tx-enable-gpios:
      type: phandle-array
      required: false
      description: TX enable pin. Controls the TX/RX switch.

    ant-diversity-gpios:
      type: phandle-array
      required: false
      description: Antenna diversity pin. Controls the antenna selection switch.
```

## modules/Kconfig.silabs
```kconfig
# Gecko and Si32 SDK

# Copyright (c) 2017, Christian Taedcke
# SPDX-License-Identifier: Apache-2.0

config HAS_SILABS_GECKO
	bool
	select HAS_CMSIS_CORE
	depends on SOC_GECKO

config HAS_SILABS_SI32
	bool
	select HAS_CMSIS_CORE
```

## samples/subsys/factory_data/sample.yaml
```yaml
sample:
  name: Factory data sample
common:
    tags: factory_data
    build_only: true

tests:
  sample.subsys.factory_data.read_write:
    platform_allow: >
      gd32f450i_eval
      native_sim
      native_sim/native/64
  sample.subsys.factory_data.read_only:
    extra_args: CONF_FILE=read_only.conf
    platform_allow:
      native_sim
      native_sim/native/64
```
